## arch/arm/hotplug/Kconfig
```kconfig
config INTELLI_PLUG
        bool "Enable intelli-plug cpu hotplug driver"
	depends on INTELLI_PLUG_HOTPLUG
        help
          Generic Intelli-plug cpu hotplug driver for ARM SOCs
```

## drivers/gpu/kcontrol_module/Kconfig
```kconfig
config KCONTROL_GPU_MODULE_MSM
        tristate
        default m
        depends on ARCH_MSM && MODULES && KALLSYMS_ALL
	help
	  Enable Advanced GPU Options in KControl for MSM Devices
```
